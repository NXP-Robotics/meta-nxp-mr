## conf/distro/imx-desktop-xwayland.conf
```bitbake
include conf/distro/fsl-imx-xwayland.conf

DISTRO = "imx-desktop-xwayland"

DISTRO_NAME = "Desktop Experience BSP"
DISTRO_VERSION = "1.0"
SDK_VENDOR = "-fslbsp"

TARGET_VENDOR = "-fsl"

SDK_NAME_PREFIX = "${DISTRO}"
SDK_NAME = "${DISTRO}-${TCLIBC}-${SDK_ARCH}-${TUNE_PKGARCH}"

# ptest is enabled by default via DISTRO_FEATURES_DEFAULTS in oe-core (wrynose).
# Opt out using DISTRO_FEATURES_OPTED_OUT (the legacy
# POKY_DEFAULT_DISTRO_FEATURES:remove no longer affects it after the rename).
DISTRO_FEATURES_OPTED_OUT:append = " ptest"
DISTRO_FEATURES_DEFAULTS:append = " benchmark vfat ext2 mtd \
    perl python usbhost virtualization pam polkit"

# Build Mesa as a glvnd EGL/GL vendor so it coexists with Ubuntu's glvnd
# dispatch instead of shipping a conflicting full libEGL. /usr/lib precedence
# then lets Mesa-Panthor win over Ubuntu's bundled mesa vendor.
DISTRO_FEATURES:append = " glvnd"
# With glvnd, libglvnd ships the dispatch (virtual/egl,libgl,libgles*) and Mesa
# is only the vendor; flip providers off the imx default of "mesa".
PREFERRED_PROVIDER_virtual/egl:forcevariable = "libglvnd"
PREFERRED_PROVIDER_virtual/libgl:forcevariable = "libglvnd"
PREFERRED_PROVIDER_virtual/libgl:imxgpu:imxmali = "libglvnd"
PREFERRED_PROVIDER_virtual/libgl:imxgpu3d:imxmali = "libglvnd"
PREFERRED_PROVIDER_virtual/libgles1:forcevariable = "libglvnd"
PREFERRED_PROVIDER_virtual/libgles2:forcevariable = "libglvnd"
PREFERRED_PROVIDER_virtual/libgles3:forcevariable = "libglvnd"

# disable network check to support offline build with sdk iso
CONNECTIVITY_CHECK_URIS = ""

# whiteliste restricted license
LICENSE_FLAGS_ACCEPTED = "non-commercial_netperf commercial_lame"

IMAGE_ROOTFS_SIZE ?= "6291456"

# UBI FS support
MKUBIFS_ARGS = "-m 512 -e 15360 -c 12000"
UBINIZE_ARGS = "-m 512 -p 16KiB -s 512"

# Having some problems with i.MX OpenCV, which is brought in by
# gstreamer1.0-plugins-bad, so disable it
PACKAGECONFIG:remove:pn-gstreamer1.0-plugins-bad = "opencv"

BBMASK += "recipes-fsl/packagegroups/packagegroup-fsl-tools-extended.bbappend"
BBMASK += "recipes-fsl/images/fsl-image-mfgtool.bbappend"

MACHINE_FEATURES:remove = "optee"
```

## conf/layer.conf
```bitbake
# We have a conf and classes directory, add to BBPATH
# Note how we PREpend BBPATH. This is due to the fact that
# bitbake does not override classes per layer as it does
# recipes. Classes are processed strictly in BBPATH order.
# As we unfortunately have to override standard classes for
# bug fixing, we prepend instead of append our path.

#This layer is a stripped down version of the AMP meta-alb layer
#meant to be used independently outside the AMP solution.
BBPATH =. "${LAYERDIR}:"

BBFILE_COLLECTIONS += "desktop-distro"
BBFILE_PATTERN_desktop-distro := "^${LAYERDIR}"
BBFILE_PRIORITY_desktop-distro = "8"

BBFILES += "${@' '.join('${LAYERDIR}/dynamic-layers/%s/recipes*/*/*.bbappend' % layer \
		for layer in BBFILE_COLLECTIONS.split())}"
BBFILES += "${@' '.join('${LAYERDIR}/dynamic-layers/%s/recipes*/*/*.bb' % layer \
		for layer in BBFILE_COLLECTIONS.split())}"

BBFILES += " \
        ${LAYERDIR}/images/*.bb* \
        ${LAYERDIR}/packagegroups/*.bb* \
        ${LAYERDIR}/recipes-*/*/*.bb \
        ${LAYERDIR}/recipes-*/*/*.bbappend \
        ${LAYERDIR}/classes/*.bb* \
"

BBMASK += "meta-freescale/recipes-graphics/gtk\+/gtk.*\.bbappend"
BBMASK += "meta-freescale/recipes-graphics/gtk\+/gtk\+3_%.bbappend"
BBMASK += "meta-imx/meta-imx-bsp/recipes-gnome/gtk\+3/gtk\+3_%.bbappend"

PYTHON_BASEVERSION:forcevariable = "3.12"

PREFERRED_PROVIDER_qemu = "qemu"
PREFERRED_VERSION_qemu-native = "9.0.2.imx"
PREFERRED_VERSION_qemu = "9.0.2.imx"
PREFERRED_VERSION_nativesdk-qemu = "9.0.2.imx"
PREFERRED_VERSION_glibc = "2.39+git"
PREFERRED_VERSION_libglib-2.0 = "2.78.6"

# Qt 6.4.3 — matches Ubuntu 24.04's libqt6 ABI (6.4.2), avoids conflicts
PREFERRED_VERSION_qtbase           = "6.4.3"
PREFERRED_VERSION_qtdeclarative    = "6.4.3"
PREFERRED_VERSION_qtshadertools    = "6.4.3"
PREFERRED_VERSION_qtsvg            = "6.4.3"
PREFERRED_VERSION_qtlanguageserver = "6.4.3"
PREFERRED_VERSION_qtwayland        = "6.4.3"
PREFERRED_VERSION_qttools          = "6.4.3"
PREFERRED_VERSION_libinput              = "1.25.0"
PREFERRED_VERSION_gobject-introspection = "1.78.1"
PREFERRED_VERSION_python3-pygobject = "3.46.0"
#PREFERRED_VERSION_python3-flit-core = "3.9.0"
#PREFERRED_VERSION_python3-build = "1.2.2"
#PREFERRED_VERSION_python3-wheel = "0.45.1"
#PREFERRED_VERSION_python3-idna = "3.10"
PREFERRED_VERSION_pango = "1.52.1"
PREFERRED_VERSION_python-native = "3.13.9"
PREFERRED_VERSION_python = "3.12.6"
PREFERRED_VERSION_openssl = "3.0.19"
PREFERRED_VERSION_openssl-native = "3.4.1"

LAYERSERIES_COMPAT_desktop-distro = "scarthgap walnascar whinlatter"

MACHINE_FEATURES:remove = "jailhouse"

FSL_BIN_MIRROR ?= "${FSL_MIRROR}"
INIT_MANAGER = "systemd"
```

## conf/machine/imx8mp-navqdesktop.conf
```bitbake
MACHINE="imx8mp-navq"
require conf/machine/imx8mp-navq.conf

MACHINE_FIRMWARE += " linux-firmware-sr150 "

KERNEL_MODULE_AUTOLOAD  += "mlan moal"
KERNEL_MODULE_PROBECONF += "moal"

module_conf_moal = "options moal fw_name=nxp/sdiouart8987_combo_v0.bin \
cal_data_cfg=none drv_mode=1 cfg80211_wext=0xf \
sta_name=wlan wfd_name=p2p max_vir_bss=1 auto_ds=2 ps_mode=2 drvdbg=0x00000000"

require conf/machine/include/ubuntubasics.inc
```

## conf/machine/imx95-19x19-lpddr5-evkdesktop.conf
```bitbake
MACHINE="imx95-19x19-lpddr5-evk"
require conf/machine/imx95-19x19-lpddr5-evk.conf

require conf/machine/include/ubuntubasics.inc
```

## conf/machine/imx95-19x19-navq.conf
```bitbake
MACHINE="imx95-19x19-navq"
require conf/machine/imx95-19x19-lpddr5-evk.conf

# A0/A1 Silicon
IMX_SOC_REV:${MACHINE} = "A0"
OEI_DDRCONFIG = "XIMX95LPD5EVK19_6400mbps_train_timing_a1"

KERNEL_DEVICETREE:append:use-nxp-bsp = " \
                     freescale/imx95-19x19-navq.dtb \
                     freescale/imx95-19x19-navq-adacorsa.dtb \
                     freescale/imx95-19x19-navq-argos.dtb \
"

KERNEL_MODULE_AUTOLOAD  += "mlan moal btnxpuart rpmsg_tty"
KERNEL_MODULE_PROBECONF += "moal"
module_conf_moal = "options moal fw_name=nxp/sduart_nw61x_v1.bin.se \
cal_data_cfg=none drv_mode=1 cfg80211_wext=0xf drvdbg=0x00000000" 
```

## conf/machine/imx95-19x19-navqdesktop.conf
```bitbake
MACHINE="imx95-19x19-navq"
require conf/machine/imx95-19x19-navq.conf

require conf/machine/include/ubuntubasics.inc
```

## conf/machine/imx95-navq.conf
```bitbake
MACHINE = "imx95-navq"
require conf/machine/imx95-19x19-lpddr5-evk.conf

# Use the open-source Mesa "panfrost" Gallium driver (kernel: panthor) as the
# sole GPU stack instead of ARM's proprietary mali-imx DDK blob. Mesa is built
# from source against the pinned glibc 2.39 (Ubuntu 24.04 ABI), whereas the
# mali-imx r54p1.6 blob requires GLIBC_2.43 and is therefore ABI-incompatible.
# Selecting only "mesa" makes mesa the provider for virtual/egl and
# virtual/libgles*, drops the proprietary blob, and keeps IMX_MALI_DUAL_DRIVER=0.
IMX_MALI_DRIVERS = "mesa"

KERNEL_DEVICETREE:append:use-nxp-bsp = " \
                     freescale/imx95-navqb.dtb \
                     freescale/imx95-navqb-display.dtb \
                     freescale/imx95-navqb-sja1110-bin.dtb \
                     freescale/imx95-navqb-lt8912b.dtb \
                     freescale/imx95-navqb-sfp.dtb \
"

KERNEL_MODULE_AUTOLOAD  += "mlan moal btnxpuart rpmsg_tty"
KERNEL_MODULE_PROBECONF += "moal"
module_conf_moal = "options moal fw_name=nxp/sduart_nw61x_v1.bin.se \
cal_data_cfg=none drv_mode=1 cfg80211_wext=0xf drvdbg=0x00000000" 
```

## conf/machine/imx95-navqa.conf
```bitbake
MACHINE="imx95-navqa"
require conf/machine/imx95-navq.conf

# A0/A1 Silicon
IMX_SOC_REV:${MACHINE} = "A0"
OEI_DDRCONFIG = "XIMX95LPD5EVK19_6400mbps_train_timing_a1"

SYSTEM_MANAGER_CONFIG = "mr-navq95a"
SYSTEM_MANAGER_MONITOR_MODE = "m2"
TARGET_NAME = "imx95-navqa"
```

## conf/machine/imx95-navqadesktop.conf
```bitbake
MACHINE="imx95-navqa"
require conf/machine/imx95-navqa.conf

require conf/machine/include/ubuntubasics.inc
```

## conf/machine/imx95-navqb-m7.conf
```bitbake
#@TYPE: Machine
#@NAME: imx95-navq-m7

#@DESCRIPTION: Machine configuration for Cortex-M7 core of NXP i.MX95 SoC.

require conf/machine/include/arm/armv7m/tune-cortexm7.inc

TUNE_FEATURES = "armv7m cortexm7"

ZEPHYR_BOARD = "mr_navq95b/mimx9596/m7"
```

## conf/machine/imx95-navqbdesktop.conf
```bitbake
MACHINE="imx95-navqb"
require conf/machine/imx95-navqb.conf

require conf/machine/include/ubuntubasics.inc
```
